## config/west.yml
```yaml
manifest:
  defaults:
    remote: urob
    revision: v0.3 # Pin everything to v0.3

  remotes:
    - name: zmkfirmware
      url-base: https://github.com/zmkfirmware
    - name: urob
      url-base: https://github.com/urob

  projects:
    - name: zmk
      remote: zmkfirmware
      import: app/west.yml

      # ZMK Modules
    - name: zmk-adaptive-key
      path: modules/zmk/adaptive-key
    - name: zmk-auto-layer
      path: modules/zmk/auto-layer
    - name: zmk-helpers
      path: modules/zmk/helpers
    - name: zmk-leader-key
      path: modules/zmk/leader-key
    - name: zmk-tri-state
      path: modules/zmk/tri-state
      
  self:
    path: config
```
