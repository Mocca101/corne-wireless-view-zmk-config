/*
* Copyright (c) 2020 The ZMK Contributors
*
* SPDX-License-Identifier: MIT
*/

#include <behaviors.dtsi>
#include <dt-bindings/zmk/bt.h>
#include <dt-bindings/zmk/keys.h>

#include "zmk-helpers/helper.h"
#include <behaviors/num_word.dtsi> // Requires zmk-auto-layer module.


// Source desired key-position labels
#include "zmk-helpers/key-labels/42.h"

#define _BT_SEL_KEYS_                                                        \
  &trans  &bt BT_SEL 0 &bt BT_SEL 1 &bt BT_SEL 2 &bt BT_SEL 3 &bt BT_CLR


/* Global defaults */
#define QUICK_TAP_MS 175
#define XXX &none
#define ___ &trans

/* Layers */

#define DEF 0
#define NAV 1
#define FN 2
#define NUM 3
#define SYS 4
#define MOUSE 5
#define SYMB 6

&lt {
	flavor = "balanced";
	tapping-term-ms = <200>;
	quick-tap-ms = <QUICK_TAP_MS>;
};

/* Homerow mods */
#define KEYS_L LT0 LT1 LT2 LT3 LT4 LM0 LM1 LM2 LM3 LM4 LB0 LB1 LB2 LB3 LB4// Left-hand keys.
#define KEYS_R RT0 RT1 RT2 RT3 RT4 RM0 RM1 RM2 RM3 RM4 RB0 RB1 RB2 RB3 RB4// Right-hand keys.
#define THUMBS LH2 LH1 LH0 RH0 RH1 RH2
// /* Left-hand HRMs. */
// ZMK_HOLD_TAP(hml,
// flavor = "balanced";
// tapping-term-ms = <280>;
// quick-tap-ms = <QUICK_TAP_MS>;
// require-prior-idle-ms = <150>;
// bindings = <&kp>, <&kp>;
// hold-trigger-key-positions = <KEYS_R THUMBS>;
// hold-trigger-on-release;
// )

// /* Right-hand HRMs. */
// ZMK_HOLD_TAP(hmr,
// flavor = "balanced";
// tapping-term-ms = <280>;
// quick-tap-ms = <QUICK_TAP_MS>;
// require-prior-idle-ms = <150>;
// bindings = <&kp>, <&kp>;
// hold-trigger-key-positions = <KEYS_L THUMBS>;
// hold-trigger-on-release;
// )

#define MAKE_HRM(NAME, HOLD, TAP, TRIGGER_POS)                                 \
  ZMK_HOLD_TAP(NAME, bindings = <HOLD>, <TAP>; flavor = "balanced";            \
               tapping-term-ms = <280>; quick-tap-ms = <QUICK_TAP_MS>;         \
               require-prior-idle-ms = <150>; hold-trigger-on-release;         \
               hold-trigger-key-positions = <TRIGGER_POS>;)

MAKE_HRM(hml, &kp, &kp, KEYS_R THUMBS) // Left-hand HRMs.
MAKE_HRM(hmr, &kp, &kp, KEYS_L THUMBS) // Right-hand HRMs.

// Hack: Make HRM combos tap-only (cf, ZMK issue #544).
#define ZMK_COMBO_8(NAME, TAP, POS, LAYERS, COMBO_MS, IDLE_MS, HOLD, SIDE)     \
  MAKE_HRM(hm_combo_##NAME, &kp, TAP, SIDE THUMBS)                             \
  ZMK_COMBO_6(NAME, &hm_combo_##NAME HOLD 0, POS, LAYERS, COMBO_MS, IDLE_MS)

/* Combos, leader key sequences, mouse emulation */

#include "combos.dtsi" // Must be sourced after HRM-combo hack.
// #include "leader.dtsi"
// #include "mouse.dtsi"


/* Nav cluster */

// Trigger tap-action on all interrupts.
#define MT_CORE                                                                \
  flavor = "tap-preferred";                                                    \
  tapping-term-ms = <220>;                                                     \
  quick-tap-ms = <220>;                                                        \
  hold-trigger-key-positions = <0>;

&mt { MT_CORE };

ZMK_HOLD_TAP(mt_home, bindings = <&masked_home>, <&kp>; MT_CORE)
ZMK_HOLD_TAP(mt_end, bindings = <&masked_end>, <&kp>; MT_CORE)

#define NAV_LEFT  &mt_home 0   LEFT  // Tap: left  | Long-tap: start of line.
#define NAV_RIGHT &mt_end 0    RIGHT // Tap: right | Long-tap: end   of line.
#define NAV_UP    &mt LC(HOME) UP    // Tap: up    | Long-tap: start of doc.
#define NAV_DOWN  &mt LC(END)  DOWN  // Tap: down  | Long-tap: end   of doc.
#define NAV_BSPC  &mt LC(BSPC) BSPC  // Tap: bspc  | Long-tap: delete word bwd.
#define NAV_DEL   &mt LC(DEL)  DEL   // Tap: del   | Long-tap: delete word fwd.


// Mask CTRL on left/right hold to avoid accidental jumps to start/end of doc.
#define MASK_MODS(NAME, MODS, BINDING)                                         \
  ZMK_MOD_MORPH(NAME, bindings = <BINDING>, <BINDING>; mods = <MODS>;)

MASK_MODS(masked_home, (MOD_LCTL), &kp HOME)
MASK_MODS(masked_end,  (MOD_LCTL), &kp END)

/* Auto-layers */

// Tap: num-word | double-tap: sticky num-layer | Hold: num-layer.
#define SMART_NUM &smart_num NUM 0

ZMK_HOLD_TAP(smart_num, bindings = <&mo>, <&num_dance>; flavor = "balanced";
             tapping-term-ms = <200>; quick-tap-ms = <QUICK_TAP_MS>;)

ZMK_TAP_DANCE(num_dance, bindings = <&num_word NUM>, <&sl NUM>;
              tapping-term-ms = <200>;)


/* Custom behaviors */
// Define mod-morph with a *single* mod trigger for less repetition.
#define SIMPLE_MORPH(NAME, MOD, BINDING1, BINDING2)                            \
  ZMK_MOD_MORPH(NAME, mods = <(MOD_L##MOD | MOD_R##MOD)>;                      \
                bindings = <BINDING1>, <BINDING2>;)

// Tap: comma | Shift + tap: semicolon | Ctrl + shift + tap: <.
SIMPLE_MORPH(comma_morph, SFT, &kp COMMA, &comma_inner_morph)
SIMPLE_MORPH(comma_inner_morph, CTL, &kp SEMICOLON, &kp LESS_THAN)

// Tap: dot | Shift + tap: colon | Ctrl + shift + tap: >.
SIMPLE_MORPH(dot_morph, SFT, &kp DOT, &dot_inner_morph)
SIMPLE_MORPH(dot_inner_morph, CTL, &kp COLON, &kp GREATER_THAN)

// Tap: qmark | Shift + tap: excl.
SIMPLE_MORPH(qexcl, SFT, &kp QMARK, &kp EXCL)

// Tap: left/right parenthesis | Shft + tap: less-than/greater-than.
SIMPLE_MORPH(lpar_lt, SFT, &kp LPAR, &kp LT)
SIMPLE_MORPH(rpar_gt, SFT, &kp RPAR, &kp GT)

// Tap: space | Shift + tap: dot -> space -> sticky shift | Hold: nav layer.
ZMK_HOLD_TAP(lt_spc, bindings = <&mo>, <&spc_morph>; flavor = "balanced";
             tapping-term-ms = <200>; quick-tap-ms = <QUICK_TAP_MS>;)
SIMPLE_MORPH(spc_morph, SFT, &kp SPACE, &dot_spc)
ZMK_MACRO(dot_spc, bindings = <&kp DOT &kp SPACE &sk LSHFT>; wait-ms = <0>;
          tap-ms = <5>;)

// Alt+Tab swapper, requires tri-state module.
ZMK_TRI_STATE(swapper, bindings = <&kt LALT>, <&kp TAB>, <&kt LALT>;
              ignored-key-positions = <LT2 RT2 RM1 RM2 RM3>;)

// Misc aliases.
#define DSK_PREV  &kp LG(LC(LEFT)) // Previous desktop.
#define DSK_NEXT  &hmr LSHIFT LG(LC(RIGHT)) // Next     desktop.
#define PIN_WIN   &kp LG(LC(LS(Q)))       // Pin window across desktops.
#define PIN_APP   &kp LG(LC(LS(A)))       // Pin application across desktops.
#define DSK_MGR   &kp LA(GRAVE)           // Desktop manager.
#define VOL_DOWN  &hmr LGUI C_VOL_DN
#define VOL_UP  	&hmr LALT C_VOL_UP


ZMK_CONDITIONAL_LAYER(sys, FN NUM, SYS) // FN + NUM --> SYS.

#ifndef ZMK_BASE_LAYER
  #define ZMK_BASE_LAYER(name, LT, RT, LM, RM, LB, RB, LH, RH)                 \
      ZMK_LAYER(name, LT RT LM RM LB RB LH RH)
#endif


ZMK_BASE_LAYER(Base,
// ╭───────────────┬───────────────┬───────────────┬───────────────┬───────────────┬───────────────╮		╭───────────────┬───────────────┬────────────────┬───────────────┬───────────────┬────────────────╮
			&kp TAB				&kp Q  						&kp W	  					&kp E					&kp R  					&kp T        ,			&kp Y						&kp U  					&kp I							&kp O    				&kp P						&kp BSPC			,
			&kp ESC  			&hml LCTRL A  		&hml LSHIFT S	 	&hml LALT D     &hml LGUI F						&kp G  ,			&kp H    		 		&hmr RGUI J  		&hmr RALT K      	&hmr RSHIFT L   &hmr RCTRL SEMI  		&kp SQT		,
			&kp LEFT_SHIFT    	&kp Z  						&kp X  						&kp C     		&kp V  					&kp B  ,			&kp N    				&kp M  					&kp COMMA  			&kp DOT  				&kp FSLH  			&kp ESC					,
																											&lt SYMB LGUI 		&lt FN RET	 &lt_spc NAV 0 ,			&lt FN RET  			SMART_NUM				&kp RALT
//																								 ╰───────────────┴───────────────┴───────────────╯		╰───────────────┴───────────────┴───────────────╯
)

// TODO: Implement Nav, Sys and Number Layers

ZMK_BASE_LAYER(Nav,
// ╭───────────────┬───────────────┬───────────────┬───────────────┬───────────────┬───────────────╮		╭───────────────┬───────────────┬────────────────┬───────────────┬───────────────┬────────────────╮
			&kp TAB				 	&kp LA(F4)			 ___           &kp LS(TAB)   			&swapper      	___        ,			___							NAV_BSPC 		    &kp PG_UP     	&kp PG_DN  	 		NAV_DEL						___					,
					___    					___    				___   					___    						___    				___		 		 ,			NAV_LEFT     		NAV_DOWN      	NAV_UP	      	NAV_RIGHT     &kp RET						___					,
					___    					___    				___   					___    						___    				___		 		 ,			&kp INS       		&kp TAB       		___           	___           	___  						___					,
																										 		___        	 			___      	 		___        ,			___        	 		___        	 		___
//																								 ╰───────────────┴───────────────┴───────────────╯		╰───────────────┴───────────────┴───────────────╯
)

ZMK_BASE_LAYER(FN,
// ╭───────────────┬───────────────┬───────────────┬───────────────┬───────────────┬───────────────╮		╭───────────────┬───────────────┬────────────────┬───────────────┬───────────────┬────────────────╮
			___				 			&kp F9	       	&kp F10        	&kp F11        	&kp F12      			___      	 ,			___     				&kp C_PREV    		&kp C_NEXT  			___							___							___					,
			___    					&hml LCTRL F5 	&hml LSHIFT F6	&hml LALT F7    &hml LGUI F8			___		 		 ,			DSK_PREV     		VOL_DOWN		    VOL_UP  				DSK_NEXT     				___							___					,
			___    					&kp F1	       	&kp F2        		&kp F3        	&kp F4     			___		 	 	 ,			PIN_APP       	PIN_WIN       	DSK_MGR           	___           	___  						___					,
																										 	___        	 		___      	 				___      	 ,			&kp C_MUTE    	&kp C_PP        	 		___
//																								 ╰───────────────┴───────────────┴───────────────╯		╰───────────────┴───────────────┴───────────────╯
)

ZMK_BASE_LAYER(Num,
// ╭───────────────┬───────────────┬───────────────┬───────────────┬───────────────┬───────────────╮		╭───────────────┬───────────────┬────────────────┬───────────────┬───────────────┬────────────────╮
			___				 			___			 				&kp N7        		&kp N8        	&kp N9      		___    		 ,			___     				___      				___        			___       			___							___					,
			___    					&hml LCTRL N0  &hml LSHIFT N4  		&hml LALT N5 	&hml LGUI N6    	___		 		 ,			___     				___      				___      				___     				___							___					,
			___    					___    					&kp N1        		&kp N2        	&kp N3    			___		 	 	 ,			___	       			___	       			___           	___           	___  						___					,
																										 	___        	 		___      	 				___      	 ,			___        	 		___        	 		___
//																								 ╰───────────────┴───────────────┴───────────────╯		╰───────────────┴───────────────┴───────────────╯
)

ZMK_BASE_LAYER(Sys,
// ╭───────────────┬───────────────┬───────────────┬───────────────┬───────────────┬───────────────╮		╭───────────────┬───────────────┬────────────────┬───────────────┬───────────────┬────────────────╮
			                            _BT_SEL_KEYS_                            							        	 ,			___     				___      				___        			___       			___							___					,
			___    					___    				___   						&bt BT_CLR    		___    					&bootloader  ,   &bootloader     		___      		&bt BT_CLR       				___     				___							___					,
			___    					___    				___   						___    					___    					&sys_reset   ,   &sys_reset	       	___	       			___           	___           	___  						___					,
																										 	___        	 		___      	 			___        	 ,			___        	 		___        	 		___
//																								 ╰───────────────┴───────────────┴───────────────╯		╰───────────────┴───────────────┴───────────────╯
)

ZMK_BASE_LAYER(MOUSE,
// ╭───────────────┬───────────────┬───────────────┬───────────────┬───────────────┬───────────────╮		╭───────────────┬───────────────┬────────────────┬───────────────┬───────────────┬────────────────╮
			___				 			___			 			___           		___   					___      				___        	 ,			___     				___      				___        			___       			___							___					,
			___    					___    				___   						___    					___    					___		 		 	 ,			___     				___      				___      				___     				___							___					,
			___    					___    				___   						___    					___    					___		 		 	 ,			___	       			___	       			___           	___           	___  						___					,
																										 	___        	 		___      	 			___        	 ,			___        	 		___        	 		___
//																								 ╰───────────────┴───────────────┴───────────────╯		╰───────────────┴───────────────┴───────────────╯
)

ZMK_BASE_LAYER(SYMB,
// ╭───────────────┬───────────────┬───────────────┬───────────────┬───────────────┬───────────────╮		╭───────────────┬───────────────┬────────────────┬───────────────┬───────────────┬────────────────╮
			___				 			&kp EXCL  		&kp AT  				&kp HASH  			&kp DLLR 	 &kp PRCNT        	 ,			&kp CARET  			&kp AMPS   			&kp ASTERISK  		&kp LPAR  			&kp RPAR					___					,
			___    					___    				___   						___    					___    					___		 		 	 ,			&kp MINUS  			&kp EQUAL  			&kp LBKT      		&kp RBKT  			&kp BSLH				&kp GRAVE			,
			___    					&kp BSLH			___   						___    					___    					___		 		 	 ,			&kp UNDER  			&kp PLUS   			&kp LBRC      		&kp RBRC  			&kp PIPE  			&kp TILDE			,
																										 	___        	 		___      	 			___        	 ,			___        	 		___        	 		___
//																								 ╰───────────────┴───────────────┴───────────────╯		╰───────────────┴───────────────┴───────────────╯
)

// &trans  &kp EXCL  &kp AT  &kp HASH  &kp DLLR  &kp PRCNT    &kp CARET  &kp AMPS   &kp ASTERISK  &kp LPAR  &kp RPAR  &kp BSPC
// &trans  &trans    &trans  &trans    &trans    &trans       &kp MINUS  &kp EQUAL  &kp LBKT      &kp RBKT  &kp BSLH  &kp GRAVE
// &trans  &trans    &trans  &trans    &trans    &trans       &kp UNDER  &kp PLUS   &kp LBRC      &kp RBRC  &kp PIPE  &kp TILDE
//                           &kp LGUI  &trans    &kp SPACE    &kp RET    &trans     &kp RALT


// ZMK_BASE_LAYER(TEMPLATE,
// // ╭───────────────┬───────────────┬───────────────┬───────────────┬───────────────┬───────────────╮		╭───────────────┬───────────────┬────────────────┬───────────────┬───────────────┬────────────────╮
// 			___				 			___			 			___           		___   					___      				___        	 ,			___     				___      				___        			___       			___							___					,
// 			___    					___    				___   						___    					___    					___		 		 	 ,			___     				___      				___      				___     				___							___					,
// 			___    					___    				___   						___    					___    					___		 		 	 ,			___	       			___	       			___           	___           	___  						___					,
// 																										 	___        	 		___      	 			___        	 ,			___        	 		___        	 		___
// //																								 ╰───────────────┴───────────────┴───────────────╯		╰───────────────┴───────────────┴───────────────╯
// )

		// raise_layer {
		// 	display-name = "Raise";
		// 	bindings = <
		// 	&trans  &kp EXCL  &kp AT  &kp HASH  &kp DLLR  &kp PRCNT    &kp CARET  &kp AMPS   &kp ASTERISK  &kp LPAR  &kp RPAR  &kp BSPC
		// 	&trans  &trans    &trans  &trans    &trans    &trans       &kp MINUS  &kp EQUAL  &kp LBKT      &kp RBKT  &kp BSLH  &kp GRAVE
		// 	&trans  &trans    &trans  &trans    &trans    &trans       &kp UNDER  &kp PLUS   &kp LBRC      &kp RBRC  &kp PIPE  &kp TILDE
		// 	&kp LGUI  &trans    &kp SPACE    &kp RET    &trans     &kp RALT
		// 	>;
		// };

